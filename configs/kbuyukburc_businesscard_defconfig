## configs/kbuyukburc_businesscard_defconfig
```kconfig
BR2_arm=y
BR2_ARM_INSTRUCTIONS_THUMB=y
BR2_SVN="svn"
BR2_CCACHE=y
BR2_SHARED_STATIC_LIBS=y
BR2_GLOBAL_PATCH_DIR="$(BR2_EXTERNAL_BUSINESSCARD_PATH)/patches"
BR2_KERNEL_HEADERS_5_1=y
BR2_TOOLCHAIN_BUILDROOT_WCHAR=y
# BR2_UCLIBC_INSTALL_UTILS is not set
BR2_GCC_VERSION_8_X=y
BR2_TOOLCHAIN_BUILDROOT_CXX=y
BR2_TARGET_GENERIC_HOSTNAME="linuxcard"
BR2_TARGET_GENERIC_ISSUE="Welcome to Businesscard Linux!"
BR2_TARGET_GENERIC_GETTY_PORT="/dev/ttyS0"
BR2_TARGET_GENERIC_GETTY_BAUDRATE_115200=y
# BR2_TARGET_GENERIC_REMOUNT_ROOTFS_RW is not set
BR2_ROOTFS_OVERLAY="$(BR2_EXTERNAL_BUSINESSCARD_PATH)/board/businesscard/rootfs_overlay"
BR2_ROOTFS_POST_BUILD_SCRIPT="$(BR2_EXTERNAL_BUSINESSCARD_PATH)/board/businesscard/v1/post-build.sh"
BR2_ROOTFS_POST_IMAGE_SCRIPT="support/scripts/genimage.sh"
BR2_ROOTFS_POST_SCRIPT_ARGS="-c $(BR2_EXTERNAL_BUSINESSCARD_PATH)/board/businesscard/v1/genimage.cfg"
BR2_LINUX_KERNEL=y
BR2_LINUX_KERNEL_CUSTOM_GIT=y
BR2_LINUX_KERNEL_CUSTOM_REPO_URL="https://github.com/kbuyukburc/linux.git"
BR2_LINUX_KERNEL_CUSTOM_REPO_VERSION="f1c100s-v5.2.2"
BR2_LINUX_KERNEL_USE_CUSTOM_CONFIG=y
BR2_LINUX_KERNEL_CUSTOM_CONFIG_FILE="$(BR2_EXTERNAL_BUSINESSCARD_PATH)/board/businesscard/v1/linux_defconfig"
BR2_LINUX_KERNEL_DTS_SUPPORT=y
BR2_LINUX_KERNEL_CUSTOM_DTS_PATH="$(BR2_EXTERNAL_BUSINESSCARD_PATH)/board/businesscard/v1/dts/businesscard.dts"
BR2_PACKAGE_DHRYSTONE=y
BR2_PACKAGE_STRESS=y
BR2_PACKAGE_MTD=y
# BR2_PACKAGE_MTD_FLASHCP is not set
# BR2_PACKAGE_MTD_FLASH_ERASE is not set
# BR2_PACKAGE_MTD_FLASH_LOCK is not set
# BR2_PACKAGE_MTD_FLASH_UNLOCK is not set
# BR2_PACKAGE_MTD_MTD_DEBUG is not set
# BR2_PACKAGE_MTD_NANDDUMP is not set
# BR2_PACKAGE_MTD_NANDTEST is not set
# BR2_PACKAGE_MTD_NANDWRITE is not set
BR2_PACKAGE_MTD_FLASH_ERASE=y
# BR2_PACKAGE_MICROPYTHON=y
# BR2_PACKAGE_MICROPYTHON_LIB=y
BR2_PACKAGE_LIBTIRPC=y
# BR2_PACKAGE_IFUPDOWN_SCRIPTS is not set
BR2_TARGET_ROOTFS_SQUASHFS=y
BR2_TARGET_ROOTFS_SQUASHFS4_XZ=y
# BR2_TARGET_ROOTFS_TAR is not set
BR2_TARGET_UBOOT=y
BR2_TARGET_UBOOT_BUILD_SYSTEM_KCONFIG=y
BR2_TARGET_UBOOT_CUSTOM_GIT=y
BR2_TARGET_UBOOT_CUSTOM_REPO_URL="https://github.com/kbuyukburc/u-boot.git"
BR2_TARGET_UBOOT_CUSTOM_REPO_VERSION="f1c100s-v2019.04"
BR2_TARGET_UBOOT_USE_CUSTOM_CONFIG=y
BR2_TARGET_UBOOT_CUSTOM_CONFIG_FILE="$(BR2_EXTERNAL_BUSINESSCARD_PATH)/board/businesscard/v1/uboot_defconfig"
BR2_TARGET_UBOOT_NEEDS_DTC=y
BR2_TARGET_UBOOT_NEEDS_PYLIBFDT=y
# BR2_TARGET_UBOOT_FORMAT_BIN is not set
BR2_TARGET_UBOOT_FORMAT_CUSTOM=y
BR2_TARGET_UBOOT_FORMAT_CUSTOM_NAME="u-boot-sunxi-with-spl.bin"
BR2_TARGET_UBOOT_CUSTOM_DTS_PATH="$(BR2_EXTERNAL_BUSINESSCARD_PATH)/board/businesscard/v1/dts/*"
BR2_PACKAGE_HOST_MKPASSWD=y
BR2_PACKAGE_HOST_MTD=y
BR2_PACKAGE_HOST_SUNXI_TOOLS_F1C100S=y
# BR2_PACKAGE_BUSINESSCARD_FLASHDRIVE=y
BR2_PACKAGE_BUSINESSCARD_SYNCDRIVE=y
# BR2_PACKAGE_2048=y
# BR2_PACKAGE_ROBOTFINDSKITTEN=y
# BR2_PACKAGE_ROGUE=y
# Kbuyukburc Package
# BR2_PACKAGE_VIM=y
BR2_PACKAGE_PYTHON=y
BR2_PACKAGE_PYTHON_NUMPYV1_8=y
BR2_PACKAGE_OPENCV3=y
BR2_PACKAGE_OPENCV3_LIB_PYTHON=y
BR2_PACKAGE_OPENCV3_LIB_CALIB3D=y
BR2_PACKAGE_OPENCV3_LIB_FEATURES2D=y
BR2_PACKAGE_OPENCV3_LIB_FLANN=y
# BR2_PACKAGE_OPENCV3_LIB_IMGCODECS=y
BR2_PACKAGE_OPENCV3_LIB_IMGPROC=y
BR2_PACKAGE_OPENCV3_LIB_ML=y
# BR2_PACKAGE_OPENCV3_LIB_OBJDETECT=y
# BR2_PACKAGE_OPENCV3_LIB_STITCHING=y
# BR2_PACKAGE_OPENCV3_WITH_JASPER=y
BR2_PACKAGE_OPENCV3_WITH_JPEG=y
BR2_PACKAGE_OPENCV3_WITH_PNG=y
# BR2_PACKAGE_OPENCV3_WITH_TIFF=y
BR2_PACKAGE_OPENCV3_LIB_VIDEOIO=y
BR2_PACKAGE_OPENCV3_LIB_OBJDETECT=y
BR2_PACKAGE_OPENCV3_LIB_STITCHING=y
BR2_PACKAGE_DOSFSTOOLS=y
# BR2_PACKAGE_DOSFSTOOLS_FATLABEL=y
# BR2_PACKAGE_DOSFSTOOLS_FSCK_FAT=y
BR2_PACKAGE_DOSFSTOOLS_MKFS_FAT=y
# BR2_PACKAGE_MTD_MKFSUBIFS=y
# BR2_PACKAGE_MTD_MKFSJFFS2=y
# BR2_PACKAGE_MTD_FLASH_ERASE=y
```

## package/businesscard-syncdrive/Config.in
```kconfig
config BR2_PACKAGE_BUSINESSCARD_SYNCDRIVE
	bool "businesscard-syncdrive"
	select BR2_PACKAGE_HOST_GENIMAGE
	select BR2_PACKAGE_HOST_DOSFSTOOLS
	select BR2_PACKAGE_DOSFSTOOLS_MKFS_FAT
	select BR2_PACKAGE_HOST_MTOOLS
	help
	  The "USB drive" image that appears when you plug my business card into
	  a PC.This flash drive is not read-only, you upload image from your PC 
	  and mount it to your file system.It will be mounted '/mnt'. If OpenCV 
	  package installed, you can do image processing on syncdrive folder.

	  https://github.com/kbuyukburc
```

## package/python-numpyV1_8/Config.in
```kconfig
config BR2_PACKAGE_PYTHON_NUMPYV1_8
	bool "python-numpyV1_8"
	# Numpy has some CPU specific code
	
	# numpy needs fenv.h. Available for all architectures in
	# glibc, but only for x86 and x86-64 in uClibc.
	help
	  NumPy is the fundamental package for scientific computing
	  with Python.

	  Note that NumPy needs fenv.h fully supported by the
	  C library.

	  http://www.numpy.org/
```
